## Kconfig.projbuild
```kconfig
menu "SM Configuration"
    config APP_WIFI_SSID
        string "WiFi SSID"
        default "myssid"
        help
            SSID (network name) for the example to connect to.

    config APP_WIFI_PASSWORD
        string "WiFi Password"
        default "mypassword"
        help
            WiFi password (WPA or WPA2) for the example to use.
            Can be left blank if the network has no security set.

    config EXAMPLE_CONNECT_IPV6
        bool "Obtain IPv6 address"
        default n
        select LWIP_IPV6
        help
            By default, examples will wait until IPv4 and IPv6 local link addresses are obtained.
            Disable this option if the network does not support IPv6.
            Choose the preferred IPv6 address type if the connection code should wait until other than
            the local link address gets assigned.

    if EXAMPLE_CONNECT_IPV6
        choice EXAMPLE_CONNECT_PREFERRED_IPV6
            prompt "Preferred IPv6 Type"
            default EXAMPLE_CONNECT_IPV6_PREF_LOCAL_LINK
            help
                Select which kind of IPv6 address the connect logic waits for.

            config EXAMPLE_CONNECT_IPV6_PREF_LOCAL_LINK
                bool "Local Link Address"
                help
                    Blocks until Local link address assigned.

            config EXAMPLE_CONNECT_IPV6_PREF_GLOBAL
                bool "Global Address"
                select LWIP_IPV6_AUTOCONFIG
                help
                    Blocks until Global address assigned.
        endchoice

    endif

    config MQTT_BROKER_URL
        string "MQTT Broker URL"
        default "mqtt://mqtt.local"
        help
            URL of the broker to connect to

    config MQTT_DEVICE_DEFAULT_PATH
        string "MQTT default path for topics"
        default "tmp"
        help
            MQTT default path for topics

endmenu
```
